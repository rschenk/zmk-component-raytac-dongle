## boards/raytac/mdbt50q_rx/Kconfig.mdbt50q_rx
```kconfig
# SPDX-License-Identifier: Apache-2.0

config BOARD_MDBT50Q_RX
	select SOC_NRF52840_QIAA
	select ZMK_BOARD_COMPAT
	imply RETAINED_MEM
	imply RETENTION
	imply RETENTION_BOOT_MODE
```
